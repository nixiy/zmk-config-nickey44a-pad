## config/west.yml
```yaml
manifest:
  remotes:
    - name: zmkfirmware
      url-base: https://github.com/zmkfirmware
    - name: cormoran
      url-base: https://github.com/cormoran
    - name: caksoylar  # <-- RGB LED
      url-base: https://github.com/caksoylar
  projects:
    - name: zmk
      remote: cormoran
      revision: 3931facea7507151a53f209ca4f8a717fa6bd400 # v0.3-branch+dya
      import: app/west.yml
    - name: zmk-rgbled-widget
      remote: caksoylar
      revision: 8756cb7b8114069fa3c25c6f6c990f24988fceff # v0.3
    - name: zmk-driver-yupad43
      url: https://github.com/yuchamichami/zmk-driver-yupad43
      revision: 5dfa6d3c480ebb5162f5425fa367823d73ddb13e # official integration baseline
  self:
    path: config
```

## dts/bindings/behaviors/zmk,behavior-scroll-inertia.yaml
```yaml
# SPDX-License-Identifier: MIT
description: Toggle IQS9151 scroll inertia on the central using deferred requests
compatible: "zmk,behavior-scroll-inertia"
include: zero_param.yaml
properties:
  device:
    type: phandle
    required: true
    description: IQS9151 device attached to the central
```
